## CMakeLists.txt
```
# SPDX-FileCopyrightText: 2026 GMaster contributors
# SPDX-License-Identifier: Apache-2.0

cmake_minimum_required(VERSION 3.20.0)

find_package(Zephyr REQUIRED HINTS $ENV{ZEPHYR_BASE})
project(gzrl_smoke)

target_sources(app PRIVATE src/main.c)
```

## sample.yaml
```
# SPDX-FileCopyrightText: 2026 GMaster contributors
# SPDX-License-Identifier: Apache-2.0

sample:
  name: GZRL module smoke sample
  description: Verifies external-module discovery and GZRL Kconfig integration.

common:
  tags:
    - gzrl
  integration_platforms:
    - native_sim
  harness: console
  harness_config:
    type: one_line
    regex:
      - "GZRL module smoke sample"

tests:
  sample.gzrl.smoke:
    platform_allow:
      - native_sim
```

## prj.conf
```kconfig
# SPDX-FileCopyrightText: 2026 GMaster contributors
# SPDX-License-Identifier: Apache-2.0

CONFIG_GZRL=y
```

## src/main.c
```c
/*
 * SPDX-FileCopyrightText: 2026 GMaster contributors
 * SPDX-License-Identifier: Apache-2.0
 */

#include <zephyr/sys/printk.h>

#ifndef CONFIG_GZRL
#error "GZRL module Kconfig was not imported"
#endif

int main(void)
{
	printk("GZRL module smoke sample\n");

	return 0;
}
```
