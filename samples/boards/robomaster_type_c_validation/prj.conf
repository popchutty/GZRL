## CMakeLists.txt
```
# SPDX-FileCopyrightText: 2026 GMaster contributors
# SPDX-License-Identifier: Apache-2.0

cmake_minimum_required(VERSION 3.20.0)

find_package(Zephyr REQUIRED HINTS $ENV{ZEPHYR_BASE})
project(robomaster_type_c_validation)

target_sources(app PRIVATE
  src/validation.cpp
  src/onboard_checks.cpp
  src/fixture_checks.cpp
  src/buzzer_score.cpp
  src/shell_commands.cpp
)
```

## sample.yaml
```
# SPDX-FileCopyrightText: 2026 GMaster contributors
# SPDX-License-Identifier: Apache-2.0

sample:
  name: RoboMaster Type C hardware validation shell
  description: Provides discoverable quick, fixture, and interactive board tests with Zephyr Shell.

common:
  tags:
    - gzrl
    - board
    - hardware
    - shell
  platform_allow:
    - robomaster_type_c
  build_only: true

tests:
  sample.gzrl.robomaster_type_c_validation: {}
```

## prj.conf
```kconfig
# SPDX-FileCopyrightText: 2026 GMaster contributors
# SPDX-License-Identifier: Apache-2.0

CONFIG_CPP=y
CONFIG_STD_CPP11=y
CONFIG_MINIMAL_LIBCPP=y

CONFIG_SERIAL=y
CONFIG_UART_LINE_CTRL=y
CONFIG_GPIO=y
CONFIG_PWM=y
CONFIG_SENSOR=y
CONFIG_ADC=y
CONFIG_SPI=y
CONFIG_I2C=y
CONFIG_CAN=y
CONFIG_ENTROPY_GENERATOR=y

CONFIG_SHELL=y
CONFIG_SHELL_HELP=y
CONFIG_SHELL_HELP_OPT_PARSE=y
CONFIG_SHELL_HELP_ON_WRONG_ARGUMENT_COUNT=y
CONFIG_SHELL_METAKEYS=y
CONFIG_SHELL_CMDS_RETURN_VALUE=y
CONFIG_SHELL_STACK_SIZE=4096
CONFIG_SHELL_CMD_BUFF_SIZE=512
CONFIG_SHELL_PROMPT_UART="type-c:~$ "
CONFIG_SHELL_BACKEND_SERIAL_CHECK_DTR=y
CONFIG_SHELL_BACKEND_SERIAL_RX_RING_BUFFER_SIZE=512

CONFIG_I2C_SHELL=y
CONFIG_DEVICE_SHELL=n
CONFIG_DATE_SHELL=n
CONFIG_DEVMEM_SHELL=n
CONFIG_KERNEL_SHELL=n
CONFIG_GPIO_SHELL=n
CONFIG_PWM_SHELL=n
CONFIG_CAN_SHELL=n
CONFIG_WDT_SHELL=n
```

## boards/robomaster_type_c.overlay
```dts
/*
 * SPDX-FileCopyrightText: 2026 GMaster contributors
 * SPDX-License-Identifier: Apache-2.0
 */
```

## src/buzzer_score.cpp
```c
/*
 * SPDX-FileCopyrightText: 2026 GMaster contributors
 * SPDX-License-Identifier: Apache-2.0
 */

#include "validation.hpp"

#include <errno.h>
#include <inttypes.h>
#include <stddef.h>
#include <stdint.h>
#include <string.h>

#include <zephyr/device.h>
#include <zephyr/devicetree.h>
#include <zephyr/drivers/pwm.h>
#include <zephyr/kernel.h>
#include <zephyr/sys/atomic.h>
#include <zephyr/sys/util.h>

namespace type_c_validation
{

const char buzzer_score_help[] =
	"Enter the monophonic buzzer score player.\n"
	"Paste one score line and press Enter; playback starts immediately.\n"
	"\n"
	"Grammar:\n"
	"  score := T<BPM> <event> [<event> ...]\n"
	"  event := <MIDI>/<duration>[.] | R/<duration>[.]\n"
	"\n"
	"BPM: 40-240 quarter-note beats per minute\n"
	"MIDI: 21-108; 60=C4, 61=C#4/Db4, 69=A4\n"
	"Duration: 1=whole, 2=half, 4=quarter, 8=eighth, 16=sixteenth\n"
	"Add '.' for a dotted duration, for example 60/4.\n"
	"Separate tokens with spaces or tabs; do not use spaces inside an event.\n"
	"Limits: 100 events, 511 characters.\n"
	"Example: T120 67/8 67/8 69/4 67/4 72/4 71/2 R/8\n"
	"\n"
	"Mode commands: help | status | stop | quit\n"
	"Ctrl+C stops playback and exits. Paste another score to replace playback.";

namespace
{

const struct pwm_dt_spec buzzer = PWM_DT_SPEC_GET(DT_ALIAS(pwm_buzzer));
constexpr uint64_t expected_cycles_per_second = 1000000ULL;
constexpr uint32_t silence_period_cycles = 250U;
constexpr uint32_t duty_divisor = 4U;
constexpr size_t score_line_size = 512U;
constexpr size_t maximum_event_count = 100U;
constexpr uint8_t rest_midi = 0U;

struct buzzer_score_event {
	uint8_t midi;
	uint8_t duration_units;
};

struct buzzer_score {
	uint16_t bpm;
	uint8_t event_count;
	uint64_t total_duration_us;
	buzzer_score_event events[maximum_event_count];
};

enum class playback_phase {
	start_event,
	tone_gap,
	complete_event,
};

struct buzzer_score_session {
	const struct pwm_dt_spec *buzzer;
	struct k_work_delayable work;
	buzzer_score score;
	size_t event_index;
	uint64_t event_duration_us;
	uint64_t tone_duration_us;
	playback_phase phase;
	atomic_t active;
	atomic_t current_event;
	atomic_t error;
};

constexpr uint32_t octave_zero_frequency_millihz[] = {
	16352U, 17324U, 18354U, 19445U, 20602U, 21827U,
	23125U, 24500U, 25957U, 27500U, 29135U, 30868U,
};

BUILD_ASSERT(ARRAY_SIZE(octave_zero_frequency_millihz) == 12U);
BUILD_ASSERT(maximum_event_count <= UINT8_MAX);

bool is_decimal_digits(const char *text)
{
	if (text == nullptr || text[0] == '\0') {
		return false;
	}

	for (const char *cursor = text; *cursor != '\0'; ++cursor) {
		if (*cursor < '0' || *cursor > '9') {
			return false;
		}
	}
	return true;
}

uint64_t duration_units_to_us(uint8_t duration_units, uint16_t bpm)
{
	const uint64_t numerator = 7500000ULL * duration_units;
	return (numerator + (bpm / 2U)) / bpm;
}

int parse_duration(const char *text, bool dotted, uint8_t &duration_units)
{
	if (!is_decimal_digits(text)) {
		return -EINVAL;
	}

	uint32_t denominator = 0U;
	if (parse_bounded_u32(text, 1U, 16U, denominator) != 0) {
		return -EINVAL;
	}

	uint8_t base_units;
	switch (denominator) {
	case 1U:
		base_units = 32U;
		break;
	case 2U:
		base_units = 16U;
		break;
	case 4U:
		base_units = 8U;
		break;
	case 8U:
		base_units = 4U;
		break;
	case 16U:
		base_units = 2U;
		break;
	default:
		return -EINVAL;
	}

	duration_units = dotted ? static_cast<uint8_t>((base_units * 3U) / 2U) : base_units;
	return 0;
}

int parse_score_event(const struct shell *shell, char *token, size_t event_index,
		      buzzer_score_event &event)
{
	char *const slash = strchr(token, '/');
	if (slash == nullptr || strchr(slash + 1, '/') != nullptr) {
		shell_error(shell, "Event %zu must contain exactly one '/': %s", event_index,
			    token);
		return -EINVAL;
	}

	*slash = '\0';
	char *const duration_text = slash + 1;
	const size_t duration_length = strlen(duration_text);
	bool dotted = false;
	if (duration_length > 0U && duration_text[duration_length - 1U] == '.') {
		duration_text[duration_length - 1U] = '\0';
		dotted = true;
	}

	if (strcmp(token, "R") == 0) {
		event.midi = rest_midi;
	} else {
		if (!is_decimal_digits(token)) {
			shell_error(shell, "Event %zu has an invalid MIDI note: %s", event_index,
				    token);
			return -EINVAL;
		}

		uint32_t midi = 0U;
		if (parse_bounded_u32(token, 21U, 108U, midi) != 0) {
			shell_error(shell, "Event %zu MIDI note must be between 21 and 108",
				    event_index);
			return -EINVAL;
		}
		event.midi = static_cast<uint8_t>(midi);
	}

	if (parse_duration(duration_text, dotted, event.duration_units) != 0) {
		shell_error(shell, "Event %zu duration must be 1, 2, 4, 8, or 16 with optional '.'",
			    event_index);
		return -EINVAL;
	}
	return 0;
}

int parse_buzzer_score(const struct shell *shell, char *line, buzzer_score &score)
{
	char *save = nullptr;
	char *tempo = strtok_r(line, " \t", &save);
	if (tempo == nullptr || tempo[0] != 'T' || !is_decimal_digits(tempo + 1)) {
		shell_error(shell, "Score must begin with T<BPM>, for example T120");
		return -EINVAL;
	}

	uint32_t bpm = 0U;
	if (parse_bounded_u32(tempo + 1, 40U, 240U, bpm) != 0) {
		shell_error(shell, "BPM must be between 40 and 240");
		return -EINVAL;
	}
	score.bpm = static_cast<uint16_t>(bpm);

	uint64_t total_duration_us = 0U;
	size_t event_count = 0U;
	for (char *token = strtok_r(nullptr, " \t", &save); token != nullptr;
	     token = strtok_r(nullptr, " \t", &save)) {
		if (event_count >= maximum_event_count) {
			shell_error(shell, "Score exceeds the %zu-event limit",
				    maximum_event_count);
			return -E2BIG;
		}

		buzzer_score_event &event = score.events[event_count];
		const int ret = parse_score_event(shell, token, event_count + 1U, event);
		if (ret != 0) {
			return ret;
		}

		total_duration_us += duration_units_to_us(event.duration_units, score.bpm);
		event_count++;
	}

	if (event_count == 0U) {
		shell_error(shell, "Score must contain at least one event");
		return -EINVAL;
	}

	score.event_count = static_cast<uint8_t>(event_count);
	score.total_duration_us = total_duration_us;
	return 0;
}

uint32_t midi_period_cycles(uint8_t midi)
{
	const uint32_t base_frequency_millihz = octave_zero_frequency_millihz[midi % 12U];
	const uint8_t octave_shift = static_cast<uint8_t>((midi / 12U) - 1U);
	const uint32_t frequency_millihz = base_frequency_millihz << octave_shift;
	const uint64_t period_numerator = expected_cycles_per_second * 1000ULL;

	return static_cast<uint32_t>((period_numerator + (frequency_millihz / 2U)) /
				     frequency_millihz);
}

int silence_buzzer(const struct pwm_dt_spec &buzzer_spec)
{
	return pwm_set_cycles(buzzer_spec.dev, buzzer_spec.channel, silence_period_cycles, 0U,
			      buzzer_spec.flags);
}

int play_midi_note(const struct pwm_dt_spec &buzzer_spec, uint8_t midi)
{
	const uint32_t period_cycles = midi_period_cycles(midi);
	return pwm_set_cycles(buzzer_spec.dev, buzzer_spec.channel, period_cycles,
			      period_cycles / duty_divisor, buzzer_spec.flags);
}

void finish_playback(buzzer_score_session &session, int error)
{
	const int cleanup_ret = silence_buzzer(*session.buzzer);
	if (error == 0 && cleanup_ret != 0) {
		error = cleanup_ret;
	}

	atomic_set(&session.error, error);
	atomic_set(&session.active, 0);
}

int schedule_transition(buzzer_score_session &session, uint64_t delay_us)
{
	if (atomic_get(&session.active) == 0) {
		return 0;
	}

	const int ret = k_work_reschedule(&session.work, K_USEC(delay_us));
	if (ret < 0) {
		finish_playback(session, ret);
		return ret;
	}
	return 0;
}

void buzzer_score_work_handler(struct k_work *work)
{
	struct k_work_delayable *const delayable = k_work_delayable_from_work(work);
	buzzer_score_session *const session = CONTAINER_OF(delayable, buzzer_score_session, work);

	if (atomic_get(&session->active) == 0) {
		return;
	}

	if (session->phase == playback_phase::complete_event) {
		session->event_index++;
		if (session->event_index >= session->score.event_count) {
			finish_playback(*session, 0);
			return;
		}
		session->phase = playback_phase::start_event;
	}

	if (session->phase == playback_phase::start_event) {
		const buzzer_score_event &event = session->score.events[session->event_index];
		atomic_set(&session->current_event,
			   static_cast<atomic_val_t>(session->event_index) + 1);
		session->event_duration_us =
			duration_units_to_us(event.duration_units, session->score.bpm);

		int ret;
		if (event.midi == rest_midi) {
			ret = silence_buzzer(*session->buzzer);
			session->phase = playback_phase::complete_event;
			if (ret == 0) {
				ret = schedule_transition(*session, session->event_duration_us);
			}
		} else {
			ret = play_midi_note(*session->buzzer, event.midi);
			session->tone_duration_us = (session->event_duration_us * 7U) / 8U;
			session->phase = playback_phase::tone_gap;
			if (ret == 0) {
				ret = schedule_transition(*session, session->tone_duration_us);
			}
		}

		if (ret != 0 && atomic_get(&session->active) != 0) {
			finish_playback(*session, ret);
		}
		return;
	}

	const int ret = silence_buzzer(*session->buzzer);
	if (ret != 0) {
		finish_playback(*session, ret);
		return;
	}

	session->phase = playback_phase::complete_event;
	const uint64_t gap_duration_us = session->event_duration_us - session->tone_duration_us;
	(void)schedule_transition(*session, gap_duration_us);
}

int stop_playback(buzzer_score_session &session)
{
	atomic_set(&session.active, 0);
	struct k_work_sync sync;
	(void)k_work_cancel_delayable_sync(&session.work, &sync);

	int ret = static_cast<int>(atomic_get(&session.error));
	const int cleanup_ret = silence_buzzer(*session.buzzer);
	if (ret == 0 && cleanup_ret != 0) {
		ret = cleanup_ret;
	}
	atomic_set(&session.error, ret);
	return ret;
}

int start_playback(buzzer_score_session &session, const buzzer_score &score)
{
	int ret = stop_playback(session);
	if (ret != 0) {
		return ret;
	}

	session.score = score;
	session.event_index = 0U;
	session.event_duration_us = 0U;
	session.tone_duration_us = 0U;
	session.phase = playback_phase::start_event;
	atomic_set(&session.current_event, 0);
	atomic_set(&session.error, 0);
	atomic_set(&session.active, 1);

	ret = k_work_schedule(&session.work, K_NO_WAIT);
	if (ret < 0) {
		finish_playback(session, ret);
		return ret;
	}
	return 0;
}

bool line_is_command(const char *line, const char *command)
{
	while (*line == ' ' || *line == '\t') {
		line++;
	}

	const size_t length = strlen(command);
	if (strncmp(line, command, length) != 0) {
		return false;
	}
	line += length;

	while (*line == ' ' || *line == '\t') {
		line++;
	}
	return *line == '\0';
}

void print_score_status(const struct shell *shell, const buzzer_score_session &session)
{
	const uint64_t duration_ms = (session.score.total_duration_us + 500U) / 1000U;
	if (atomic_get(&session.active) != 0) {
		shell_print(shell, "Score: playing event %ld/%u, total=%" PRIu64 " ms",
			    static_cast<long>(atomic_get(&session.current_event)),
			    session.score.event_count, duration_ms);
	} else if (session.score.event_count != 0U) {
		shell_print(shell, "Score: idle, last score events=%u total=%" PRIu64 " ms",
			    session.score.event_count, duration_ms);
	} else {
		shell_print(shell, "Score: idle, no score loaded");
	}
}

} // namespace

int run_buzzer_score(const struct shell *shell)
{
	if (!pwm_is_ready_dt(&buzzer)) {
		shell_error(shell, "Buzzer PWM controller is not ready");
		return -ENODEV;
	}

	uint64_t cycles_per_second = 0U;
	int ret = pwm_get_cycles_per_sec(buzzer.dev, buzzer.channel, &cycles_per_second);
	if (ret != 0) {
		shell_error(shell, "Failed to read buzzer PWM clock (%d)", ret);
		return ret;
	}
	if (cycles_per_second != expected_cycles_per_second) {
		(void)silence_buzzer(buzzer);
		shell_error(shell,
			    "Buzzer score requires a 1 MHz PWM clock; got %" PRIu64
			    " Hz. Check the board Devicetree configuration.",
			    cycles_per_second);
		return -ENOTSUP;
	}

	buzzer_score_session session = {};
	session.buzzer = &buzzer;
	k_work_init_delayable(&session.work, buzzer_score_work_handler);
	atomic_set(&session.active, 0);
	atomic_set(&session.current_event, 0);
	atomic_set(&session.error, 0);

	ret = silence_buzzer(buzzer);
	if (ret != 0) {
		shell_error(shell, "Failed to establish inactive buzzer output (%d)", ret);
		return ret;
	}

	shell_print(shell, "%s", buzzer_score_help);
	shell_print(shell, "Tab completion and history are unavailable inside this session.");

	uint8_t line_buffer[score_line_size] = {};
	char *const line = reinterpret_cast<char *>(line_buffer);
	int result = 0;

	for (;;) {
		ret = shell_readline(shell, line_buffer, sizeof(line_buffer), K_FOREVER);
		if (ret == -ECANCELED) {
			break;
		}
		if (ret < 0) {
			shell_error(shell, "Score input failed (%d)", ret);
			result = ret;
			break;
		}

		const int playback_error = static_cast<int>(atomic_get(&session.error));
		if (playback_error != 0) {
			shell_error(shell, "Buzzer playback failed (%d)", playback_error);
			result = playback_error;
			break;
		}

		if (line_is_command(line, "help")) {
			shell_print(shell, "%s", buzzer_score_help);
			continue;
		}
		if (line_is_command(line, "status")) {
			print_score_status(shell, session);
			continue;
		}
		if (line_is_command(line, "stop")) {
			ret = stop_playback(session);
			if (ret != 0) {
				shell_error(shell, "Failed to stop buzzer playback (%d)", ret);
				result = ret;
				break;
			}
			shell_print(shell, "Buzzer score playback stopped");
			continue;
		}
		if (line_is_command(line, "quit")) {
			break;
		}

		buzzer_score candidate = {};
		ret = parse_buzzer_score(shell, line, candidate);
		if (ret != 0) {
			continue;
		}

		ret = start_playback(session, candidate);
		if (ret != 0) {
			shell_error(shell, "Failed to start buzzer playback (%d)", ret);
			result = ret;
			break;
		}
		shell_print(shell, "Playing %u events for %" PRIu64 " ms", candidate.event_count,
			    (candidate.total_duration_us + 500U) / 1000U);
	}

	const int cleanup_ret = stop_playback(session);
	if (result == 0 && cleanup_ret != 0) {
		shell_error(shell, "Final buzzer cleanup failed (%d)", cleanup_ret);
		result = cleanup_ret;
	}
	return result;
}

} // namespace type_c_validation
```

## src/fixture_checks.cpp
```c
/*
 * SPDX-FileCopyrightText: 2026 GMaster contributors
 * SPDX-License-Identifier: Apache-2.0
 */

#include "validation.hpp"

#include <errno.h>
#include <inttypes.h>
#include <string.h>

#include <zephyr/device.h>
#include <zephyr/devicetree.h>
#include <zephyr/drivers/can.h>
#include <zephyr/drivers/pwm.h>
#include <zephyr/drivers/spi.h>
#include <zephyr/drivers/uart.h>
#include <zephyr/kernel.h>

namespace type_c_validation
{

namespace
{

CAN_MSGQ_DEFINE(can_physical_msgq, 2);
K_SEM_DEFINE(can_physical_tx_sem, 0, 1);
int can_physical_tx_result;

void can_physical_tx_callback(const struct device *device, int error, void *user_data)
{
	ARG_UNUSED(device);
	ARG_UNUSED(user_data);
	can_physical_tx_result = error;
	k_sem_give(&can_physical_tx_sem);
}

int can_physical_send_bounded(const struct device *can, const struct can_frame &frame)
{
	k_sem_reset(&can_physical_tx_sem);
	can_physical_tx_result = -EINPROGRESS;
	int ret = can_send(can, &frame, K_MSEC(200), can_physical_tx_callback, nullptr);
	if (ret != 0) {
		return ret;
	}

	ret = k_sem_take(&can_physical_tx_sem, K_MSEC(500));
	if (ret != 0) {
		return -ETIMEDOUT;
	}
	return can_physical_tx_result;
}

constexpr uint8_t loopback_pattern[] = {
	0x00, 0x55, 0xaa, 0xff, 0x12, 0x34, 0x7e, 0x81,
};

struct servo_channel {
	const char *name;
	const struct device *pwm;
	uint32_t channel;
};

const struct device *const servo_pwm1 = DEVICE_DT_GET(DT_NODELABEL(pwm1));
const struct device *const servo_pwm8 = DEVICE_DT_GET(DT_NODELABEL(pwm8));
const struct pwm_dt_spec buzzer = PWM_DT_SPEC_GET(DT_ALIAS(pwm_buzzer));
const servo_channel servo_channels[] = {
	{"PWM1", servo_pwm1, 1U}, {"PWM2", servo_pwm1, 2U}, {"PWM3", servo_pwm1, 3U},
	{"PWM4", servo_pwm1, 4U}, {"PWM5", servo_pwm8, 1U}, {"PWM6", servo_pwm8, 2U},
	{"PWM7", servo_pwm8, 3U},
};

void drain_uart(const struct device *uart)
{
	unsigned char byte = 0U;
	const int64_t deadline = k_uptime_get() + 10;

	for (size_t count = 0; count < 32U && k_uptime_get() < deadline; count++) {
		if (uart_poll_in(uart, &byte) != 0) {
			break;
		}
	}
}

int uart_exchange(const struct device *uart)
{
	unsigned char byte = 0U;

	for (uint8_t expected : loopback_pattern) {
		uart_poll_out(uart, expected);
		const int64_t deadline = k_uptime_get() + 200;
		int ret;

		do {
			ret = uart_poll_in(uart, &byte);
			if (ret != 0) {
				k_yield();
			}
		} while (ret != 0 && k_uptime_get() < deadline);

		if (ret != 0) {
			return -ETIMEDOUT;
		}
		if (byte != expected) {
			return -EIO;
		}
	}

	return 0;
}

int spi_exchange(const struct device *spi, uint32_t frequency)
{
	uint8_t tx_data[sizeof(loopback_pattern)] = {};
	uint8_t rx_data[sizeof(loopback_pattern)] = {};
	memcpy(tx_data, loopback_pattern, sizeof(tx_data));

	struct spi_config config = {};
	config.frequency = frequency;
	config.operation = SPI_OP_MODE_MASTER | SPI_TRANSFER_MSB | SPI_WORD_SET(8);
	config.slave = 0U;

	struct spi_buf tx_buffer = {tx_data, sizeof(tx_data)};
	struct spi_buf rx_buffer = {rx_data, sizeof(rx_data)};
	struct spi_buf_set tx_set = {&tx_buffer, 1U};
	struct spi_buf_set rx_set = {&rx_buffer, 1U};

	const int ret = spi_transceive(spi, &config, &tx_set, &rx_set);
	if (ret != 0) {
		return ret;
	}

	return memcmp(tx_data, rx_data, sizeof(tx_data)) == 0 ? 0 : -EIO;
}

bool can_frames_equal(const struct can_frame &expected, const struct can_frame &received)
{
	return expected.flags == received.flags && expected.id == received.id &&
	       expected.dlc == received.dlc &&
	       memcmp(expected.data, received.data, can_dlc_to_bytes(expected.dlc)) == 0;
}

int can_exchange(const struct device *transmitter, const struct device *receiver, uint32_t id)
{
	struct can_filter filter = {};
	struct can_frame frame = {};
	struct can_frame received = {};

	filter.flags = 0U;
	filter.id = id;
	filter.mask = CAN_STD_ID_MASK;

	k_msgq_purge(&can_physical_msgq);
	const int filter_id = can_add_rx_filter_msgq(receiver, &can_physical_msgq, &filter);
	if (filter_id < 0) {
		return filter_id;
	}

	frame.flags = 0U;
	frame.id = id;
	frame.dlc = 8U;
	memcpy(frame.data, loopback_pattern, sizeof(loopback_pattern));

	int ret = can_physical_send_bounded(transmitter, frame);
	if (ret == 0) {
		ret = k_msgq_get(&can_physical_msgq, &received, K_SECONDS(1));
	}

	can_remove_rx_filter(receiver, filter_id);
	if (ret != 0) {
		return ret;
	}

	return can_frames_equal(frame, received) ? 0 : -EIO;
}

void print_can_state(const reporter &reporter, const char *name, const struct device *can)
{
	enum can_state state;
	struct can_bus_err_cnt error_count = {};
	const int ret = can_get_state(can, &state, &error_count);

	if (ret == 0) {
		shell_print(reporter.output(), "[INFO] %s: state=%d tx_errors=%u rx_errors=%u",
			    name, static_cast<int>(state), error_count.tx_err_cnt,
			    error_count.rx_err_cnt);
	}
}

int prepare_can(const struct device *can, bool &started)
{
	started = false;
	int ret = can_stop(can);
	if (ret == -EALREADY) {
		ret = 0;
	}
	if (ret == 0) {
		ret = can_set_mode(can, 0U);
	}
	if (ret == 0) {
		ret = can_set_bitrate(can, 1000000U);
	}
	if (ret == 0) {
		ret = can_start(can);
		started = ret == 0;
	}

	return ret;
}

int cleanup_can(const struct device *can, bool started)
{
	int ret = 0;
	if (started) {
		ret = can_stop(can);
	}

	const int mode_ret = can_set_mode(can, 0U);
	if (ret == 0 && mode_ret != 0) {
		ret = mode_ret;
	}
	return ret;
}

int set_pwm(const struct device *pwm, uint32_t channel, uint32_t period, uint32_t pulse)
{
	return pwm_set(pwm, channel, period, pulse, PWM_POLARITY_NORMAL);
}

int set_buzzer(uint32_t period, uint32_t pulse)
{
	return pwm_set_dt(&buzzer, period, pulse);
}

int disable_all_servos()
{
	int first_error = 0;

	for (const servo_channel &servo : servo_channels) {
		const int ret = set_pwm(servo.pwm, servo.channel, PWM_MSEC(20), 0U);
		if (ret != 0 && first_error == 0) {
			first_error = ret;
		}
	}
	return first_error;
}

} // namespace

void validate_uart_loopback(reporter &reporter, uart_port port)
{
	const struct device *uart;
	const char *name;
	const char *fixture;

	if (port == uart_port::usart1) {
		uart = DEVICE_DT_GET(DT_NODELABEL(usart1));
		name = "uart.usart1.loopback";
		fixture = "jumper PA9 TX to PB7 RX (connector marked UART2)";
	} else {
		uart = DEVICE_DT_GET(DT_NODELABEL(usart6));
		name = "uart.usart6.loopback";
		fixture = "jumper PG14 TX to PG9 RX (connector marked UART1)";
	}

	reporter.info(name, fixture);
	if (!device_is_ready(uart)) {
		reporter.record(result_kind::error, name, "device is not ready");
		return;
	}

	struct uart_config original = {};
	int ret = uart_config_get(uart, &original);
	if (ret != 0) {
		reporter.record(result_kind::error, name, "failed to read current configuration",
				ret);
		return;
	}

	struct uart_config test_config = {};
	test_config.baudrate = 115200U;
	test_config.parity = UART_CFG_PARITY_NONE;
	test_config.stop_bits = UART_CFG_STOP_BITS_1;
	test_config.data_bits = UART_CFG_DATA_BITS_8;
	test_config.flow_ctrl = UART_CFG_FLOW_CTRL_NONE;

	const int configure_ret = uart_configure(uart, &test_config);
	ret = configure_ret;
	if (ret == 0) {
		drain_uart(uart);
		ret = uart_exchange(uart);
	}

	const int restore_ret = uart_configure(uart, &original);
	if (ret != 0) {
		reporter.record(result_kind::error, name,
				configure_ret != 0 ? "failed to configure 115200 8N1"
						   : "115200 8N1 loopback did not match",
				ret);
		if (restore_ret != 0) {
			reporter.record(result_kind::error, name,
					"failed to restore UART configuration", restore_ret);
		}
	} else if (restore_ret != 0) {
		reporter.record(result_kind::error, name, "test passed but UART restoration failed",
				restore_ret);
	} else {
		reporter.record(result_kind::success, name, "115200 8N1 polling loopback matched");
	}
}

void validate_spi2_loopback(reporter &reporter)
{
	const struct device *const spi2 = DEVICE_DT_GET(DT_NODELABEL(spi2));

	reporter.info("fixture.spi2", "jumper PB15 MOSI to PB14 MISO; CS is not exercised");
	if (!device_is_ready(spi2)) {
		reporter.record(result_kind::error, "spi.spi2.loopback", "device is not ready");
		return;
	}

	const uint32_t frequencies[] = {500000U, 4000000U};
	for (uint32_t frequency : frequencies) {
		const int ret = spi_exchange(spi2, frequency);
		if (ret != 0) {
			reporter.record(result_kind::error, "spi.spi2.loopback",
					"transfer did not match", ret);
			return;
		}
		shell_print(reporter.output(),
			    "[INFO] spi.spi2.loopback: matched at %" PRIu32 " Hz", frequency);
	}

	reporter.record(result_kind::success, "spi.spi2.loopback",
			"MOSI-to-MISO transfers matched at two frequencies");
}

void validate_can_physical(reporter &reporter)
{
	const struct device *const can1 = DEVICE_DT_GET(DT_NODELABEL(can1));
	const struct device *const can2 = DEVICE_DT_GET(DT_NODELABEL(can2));
	bool can1_started = false;
	bool can2_started = false;

	reporter.info("fixture.can", "connect CAN1 H/L/GND to CAN2 H/L/GND; add no termination");
	if (!device_is_ready(can1) || !device_is_ready(can2)) {
		reporter.record(result_kind::error, "can.physical", "CAN controller is not ready");
		return;
	}

	int setup_ret = prepare_can(can1, can1_started);
	if (setup_ret == 0) {
		setup_ret = prepare_can(can2, can2_started);
	}

	int first_exchange_ret = 0;
	int second_exchange_ret = 0;
	if (setup_ret == 0) {
		first_exchange_ret = can_exchange(can1, can2, 0x521U);
		if (first_exchange_ret == 0) {
			second_exchange_ret = can_exchange(can2, can1, 0x522U);
		}
	}

	if (first_exchange_ret != 0 || second_exchange_ret != 0) {
		print_can_state(reporter, "can1", can1);
		print_can_state(reporter, "can2", can2);
	}

	int cleanup_ret = cleanup_can(can1, can1_started);
	const int can2_cleanup_ret = cleanup_can(can2, can2_started);
	if (cleanup_ret == 0 && can2_cleanup_ret != 0) {
		cleanup_ret = can2_cleanup_ret;
	}

	if (setup_ret != 0) {
		reporter.record(result_kind::error, "can.physical", "controller setup failed",
				setup_ret);
		if (cleanup_ret != 0) {
			reporter.record(result_kind::error, "can.physical",
					"controller cleanup failed", cleanup_ret);
		}
		return;
	}
	if (cleanup_ret != 0) {
		reporter.record(result_kind::error, "can.physical", "controller cleanup failed",
				cleanup_ret);
		return;
	}
	if (first_exchange_ret != 0) {
		reporter.record(result_kind::error, "can.physical", "CAN1-to-CAN2 exchange failed",
				first_exchange_ret);
		return;
	}

	reporter.record(result_kind::success, "can.can1_to_can2", "1 Mbit/s frame matched");
	if (second_exchange_ret != 0) {
		reporter.record(result_kind::error, "can.physical", "CAN2-to-CAN1 exchange failed",
				second_exchange_ret);
		return;
	}
	reporter.record(result_kind::success, "can.can2_to_can1", "1 Mbit/s frame matched");
}

void validate_buzzer_instrumentation(reporter &reporter)
{
	const uint32_t period = buzzer.period;
	const uint32_t pulse = period / 4U;

	if (!pwm_is_ready_dt(&buzzer)) {
		reporter.record(result_kind::error, "pwm.buzzer.instrumentation",
				"PWM controller is not ready");
		return;
	}

	shell_print(reporter.output(),
		    "[INFO] pwm.buzzer: period=%" PRIu32 " ns pulse=%" PRIu32
		    " ns duration=1000 ms",
		    period, pulse);
	int ret = set_buzzer(period, pulse);
	if (ret == 0) {
		k_sleep(K_SECONDS(1));
	}

	const int cleanup_ret = set_buzzer(period, 0U);
	if (ret != 0) {
		reporter.record(result_kind::error, "pwm.buzzer.instrumentation",
				"failed to generate bounded 4 kHz tone", ret);
	} else if (cleanup_ret != 0) {
		reporter.record(result_kind::error, "pwm.buzzer.instrumentation",
				"failed to disable buzzer output", cleanup_ret);
	} else {
		reporter.record(result_kind::success, "pwm.buzzer.instrumentation",
				"bounded 4 kHz, 25 percent duty tone generated and disabled");
	}
}

namespace
{

void print_buzzer_interactive_help(const struct shell *shell)
{
	shell_print(shell, "Commands:");
	shell_print(shell, "  set <frequency 100-5000 Hz> <duty 1-50 percent>");
	shell_print(shell, "  off | status | help | pass | fail | quit");
	shell_print(shell,
		    "The setting remains active until changed, turned off, or the session exits.");
	shell_print(shell, "Tab completion and history are unavailable inside this session.");
}

void print_servo_interactive_help(const struct shell *shell, uint32_t channel)
{
	shell_print(shell, "PWM%u signal only; do not attach a servo or load.", channel);
	shell_print(shell, "Commands:");
	shell_print(shell, "  pulse <1000-2000 microseconds>");
	shell_print(shell, "  off | status | help | pass | fail | quit");
	shell_print(shell,
		    "The setting remains active until changed, turned off, or the session exits.");
	shell_print(shell, "Tab completion and history are unavailable inside this session.");
}

} // namespace

int run_buzzer_interactive(const struct shell *shell)
{
	const test_descriptor *const test = find_test("buzzer.interactive");
	if (test == nullptr) {
		return -ENOENT;
	}

	reporter reporter(shell);
	reporter.begin_test(*test);
	if (!pwm_is_ready_dt(&buzzer)) {
		reporter.record(result_kind::error, "pwm.buzzer", "PWM controller is not ready");
		reporter.end_test();
		return reporter.finish();
	}

	uint32_t frequency = 4000U;
	uint32_t duty = 25U;
	uint32_t period = buzzer.period;
	bool active = false;
	bool operated = false;
	bool verdict_recorded = false;
	uint8_t line_buffer[64] = {};
	char *const line = reinterpret_cast<char *>(line_buffer);
	int ret = set_buzzer(period, 0U);
	if (ret != 0) {
		reporter.record(result_kind::error, "pwm.buzzer",
				"failed to establish inactive state", ret);
		reporter.end_test();
		return reporter.finish();
	}
	print_buzzer_interactive_help(shell);

	for (;;) {
		ret = shell_readline(shell, line_buffer, sizeof(line_buffer), K_FOREVER);
		if (ret == -ECANCELED) {
			break;
		}
		if (ret < 0) {
			reporter.record(result_kind::error, "pwm.buzzer",
					"interactive input failed", ret);
			break;
		}

		char *save = nullptr;
		char *command = strtok_r(line, " ", &save);
		if (command == nullptr) {
			continue;
		}
		if (strcmp(command, "help") == 0) {
			print_buzzer_interactive_help(shell);
			continue;
		}
		if (strcmp(command, "status") == 0) {
			shell_print(shell, "Buzzer: frequency=%u Hz duty=%u%% %s", frequency, duty,
				    active ? "active" : "off");
			continue;
		}
		if (strcmp(command, "off") == 0) {
			ret = set_buzzer(period, 0U);
			active = false;
			if (ret != 0) {
				reporter.record(result_kind::error, "pwm.buzzer",
						"failed to turn output off", ret);
				break;
			}
			continue;
		}
		if (strcmp(command, "pass") == 0 || strcmp(command, "fail") == 0) {
			verdict_recorded = true;
			if (strcmp(command, "pass") == 0 && operated) {
				reporter.record(result_kind::success, "pwm.buzzer.operator",
						"operator confirmed buzzer behavior");
			} else if (strcmp(command, "pass") == 0) {
				reporter.record(result_kind::not_tested, "pwm.buzzer.operator",
						"no tone was exercised", -EAGAIN);
			} else {
				reporter.record(result_kind::error, "pwm.buzzer.operator",
						"operator observed incorrect buzzer behavior",
						-EIO);
			}
			break;
		}
		if (strcmp(command, "quit") == 0) {
			break;
		}
		if (strcmp(command, "set") == 0) {
			char *frequency_text = strtok_r(nullptr, " ", &save);
			char *duty_text = strtok_r(nullptr, " ", &save);
			char *extra = strtok_r(nullptr, " ", &save);
			uint32_t new_frequency = 0U;
			uint32_t new_duty = 0U;
			if (frequency_text == nullptr || duty_text == nullptr || extra != nullptr ||
			    parse_bounded_u32(frequency_text, 100U, 5000U, new_frequency) != 0 ||
			    parse_bounded_u32(duty_text, 1U, 50U, new_duty) != 0) {
				ret = set_buzzer(period, 0U);
				if (ret != 0) {
					reporter.record(result_kind::error, "pwm.buzzer",
							"shutdown after invalid input failed", ret);
					break;
				}
				active = false;
				shell_error(shell,
					    "Expected: set <frequency 100-5000> <duty 1-50>");
				continue;
			}

			const uint32_t new_period =
				static_cast<uint32_t>(1000000000ULL / new_frequency);
			const uint32_t pulse = static_cast<uint32_t>(
				(static_cast<uint64_t>(new_period) * new_duty) / 100U);
			ret = set_buzzer(new_period, pulse);
			if (ret != 0) {
				(void)set_buzzer(period, 0U);
				reporter.record(result_kind::error, "pwm.buzzer",
						"failed to apply buzzer setting", ret);
				break;
			}
			frequency = new_frequency;
			duty = new_duty;
			period = new_period;
			active = true;
			operated = true;
			shell_print(shell, "Buzzer set: frequency=%u Hz duty=%u%%", frequency,
				    duty);
			continue;
		}

		ret = set_buzzer(period, 0U);
		if (ret != 0) {
			reporter.record(result_kind::error, "pwm.buzzer",
					"shutdown after unknown command failed", ret);
			break;
		}
		active = false;
		shell_error(shell, "Unknown command; enter help");
	}

	const int cleanup_ret = set_buzzer(period, 0U);
	if (cleanup_ret != 0) {
		reporter.record(result_kind::error, "pwm.buzzer", "final cleanup failed",
				cleanup_ret);
	} else if (!reporter.current_test_has_error() && !verdict_recorded) {
		reporter.record(result_kind::not_tested, "pwm.buzzer.operator",
				"session ended without an operator verdict", -ECANCELED);
	}
	reporter.end_test();
	return reporter.finish();
}

int run_servo_interactive(const struct shell *shell, uint32_t channel)
{
	const test_descriptor *const test = find_test("servo.interactive");
	if (test == nullptr) {
		return -ENOENT;
	}

	reporter reporter(shell);
	reporter.begin_test(*test);
	if (!device_is_ready(servo_pwm1) || !device_is_ready(servo_pwm8)) {
		reporter.record(result_kind::error, "pwm.servo", "PWM controller is not ready");
		reporter.end_test();
		return reporter.finish();
	}
	if (channel == 0U || channel > ARRAY_SIZE(servo_channels)) {
		reporter.record(result_kind::error, "pwm.servo", "channel is outside 1-7", -EINVAL);
		reporter.end_test();
		return reporter.finish();
	}

	const servo_channel &servo = servo_channels[channel - 1U];
	constexpr uint32_t period = PWM_MSEC(20);
	uint32_t pulse_us = 0U;
	bool active = false;
	bool operated = false;
	bool verdict_recorded = false;
	uint8_t line_buffer[48] = {};
	char *const line = reinterpret_cast<char *>(line_buffer);
	int ret = disable_all_servos();
	if (ret != 0) {
		reporter.record(result_kind::error, "pwm.servo",
				"failed to establish inactive state", ret);
		reporter.end_test();
		return reporter.finish();
	}
	print_servo_interactive_help(shell, channel);

	for (;;) {
		ret = shell_readline(shell, line_buffer, sizeof(line_buffer), K_FOREVER);
		if (ret == -ECANCELED) {
			break;
		}
		if (ret < 0) {
			reporter.record(result_kind::error, "pwm.servo", "interactive input failed",
					ret);
			break;
		}

		char *save = nullptr;
		char *command = strtok_r(line, " ", &save);
		if (command == nullptr) {
			continue;
		}
		if (strcmp(command, "help") == 0) {
			print_servo_interactive_help(shell, channel);
			continue;
		}
		if (strcmp(command, "status") == 0) {
			shell_print(shell, "PWM%u: pulse=%u us %s", channel, pulse_us,
				    active ? "active" : "off");
			continue;
		}
		if (strcmp(command, "off") == 0) {
			ret = disable_all_servos();
			active = false;
			pulse_us = 0U;
			if (ret != 0) {
				reporter.record(result_kind::error, "pwm.servo",
						"failed to turn all outputs off", ret);
				break;
			}
			continue;
		}
		if (strcmp(command, "pass") == 0 || strcmp(command, "fail") == 0) {
			verdict_recorded = true;
			if (strcmp(command, "pass") == 0 && operated) {
				reporter.record(result_kind::success, "pwm.servo.instrumentation",
						"operator confirmed the measured signal");
			} else if (strcmp(command, "pass") == 0) {
				reporter.record(result_kind::not_tested,
						"pwm.servo.instrumentation",
						"no pulse setting was exercised", -EAGAIN);
			} else {
				reporter.record(result_kind::error, "pwm.servo.instrumentation",
						"measured signal did not match", -EIO);
			}
			break;
		}
		if (strcmp(command, "quit") == 0) {
			break;
		}
		if (strcmp(command, "pulse") == 0) {
			char *pulse_text = strtok_r(nullptr, " ", &save);
			char *extra = strtok_r(nullptr, " ", &save);
			uint32_t new_pulse_us = 0U;
			if (pulse_text == nullptr || extra != nullptr ||
			    parse_bounded_u32(pulse_text, 1000U, 2000U, new_pulse_us) != 0) {
				ret = disable_all_servos();
				if (ret != 0) {
					reporter.record(result_kind::error, "pwm.servo",
							"shutdown after invalid input failed", ret);
					break;
				}
				active = false;
				pulse_us = 0U;
				shell_error(shell, "Expected: pulse <1000-2000>");
				continue;
			}

			ret = disable_all_servos();
			if (ret == 0) {
				ret = set_pwm(servo.pwm, servo.channel, period,
					      PWM_USEC(new_pulse_us));
			}
			if (ret != 0) {
				(void)disable_all_servos();
				reporter.record(result_kind::error, "pwm.servo",
						"failed to apply servo signal", ret);
				break;
			}
			pulse_us = new_pulse_us;
			active = true;
			operated = true;
			shell_print(shell, "PWM%u set: period=20000 us pulse=%u us", channel,
				    pulse_us);
			continue;
		}

		ret = disable_all_servos();
		if (ret != 0) {
			reporter.record(result_kind::error, "pwm.servo",
					"shutdown after unknown command failed", ret);
			break;
		}
		active = false;
		pulse_us = 0U;
		shell_error(shell, "Unknown command; enter help");
	}

	const int cleanup_ret = disable_all_servos();
	if (cleanup_ret != 0) {
		reporter.record(result_kind::error, "pwm.servo", "final cleanup failed",
				cleanup_ret);
	} else if (!reporter.current_test_has_error() && !verdict_recorded) {
		reporter.record(result_kind::not_tested, "pwm.servo.instrumentation",
				"session ended without a measurement verdict", -ECANCELED);
	}
	reporter.end_test();
	return reporter.finish();
}

} // namespace type_c_validation
```

## src/validation.cpp
```c
/*
 * SPDX-FileCopyrightText: 2026 GMaster contributors
 * SPDX-License-Identifier: Apache-2.0
 */

#include "validation.hpp"

#include <errno.h>
#include <inttypes.h>
#include <string.h>

#include <zephyr/shell/shell_string_conv.h>
#include <zephyr/sys/util.h>

namespace type_c_validation
{

namespace
{

const char *result_name(result_kind kind)
{
	switch (kind) {
	case result_kind::success:
		return "SUCCESS";
	case result_kind::error:
		return "ERROR";
	case result_kind::not_tested:
		return "NOT TESTED";
	}

	return "UNKNOWN";
}

const test_descriptor tests[] = {
	{"info", "info", "test info", "Show board, firmware, shell, and safety information.",
	 validation_depth::readiness, "none", test_flag_none, validate_system_info},
	{"clock", "clock", "test clock", "Check configured clock and kernel timing cadence.",
	 validation_depth::functional, "none", test_flag_quick, validate_clock},
	{"devices", "devices", "test devices", "Check curated onboard device initialization.",
	 validation_depth::readiness, "none", test_flag_quick, validate_devices},
	{"entropy", "entropy", "test entropy", "Perform two guarded entropy reads.",
	 validation_depth::functional, "none", test_flag_quick, validate_entropy},
	{"battery", "battery", "test battery", "Read the onboard battery voltage divider.",
	 validation_depth::functional, "none", test_flag_quick, validate_battery},
	{"accel", "accel", "test accel", "Read one BMI088 accelerometer XYZ sample.",
	 validation_depth::functional, "none", test_flag_quick, validate_accelerometer},
	{"accel.interactive", "accel", "test accel interactive",
	 "Report BMI088 accelerometer XYZ changes until Ctrl+C.", validation_depth::functional,
	 "move the board", test_flag_none, nullptr},
	{"gyro", "gyro", "test gyro", "Read one BMI088 gyroscope XYZ sample.",
	 validation_depth::functional, "none", test_flag_quick, validate_gyroscope},
	{"gyro.interactive", "gyro", "test gyro interactive",
	 "Report BMI088 gyroscope XYZ changes until Ctrl+C.", validation_depth::functional,
	 "rotate the board", test_flag_none, nullptr},
	{"magn", "magn", "test magn", "Read one IST8310 magnetometer XYZ sample.",
	 validation_depth::functional, "none", test_flag_quick, validate_magnetometer},
	{"magn.interactive", "magn", "test magn interactive",
	 "Report IST8310 magnetometer XYZ changes until Ctrl+C.", validation_depth::functional,
	 "rotate the board", test_flag_none, nullptr},
	{"uart1", "uart", "test uart 1", "Run the USART1 115200 8N1 physical loopback.",
	 validation_depth::physical_fixture, "jumper PA9 TX to PB7 RX", test_flag_none, nullptr},
	{"uart6", "uart", "test uart 6", "Run the USART6 115200 8N1 physical loopback.",
	 validation_depth::physical_fixture, "jumper PG14 TX to PG9 RX", test_flag_none, nullptr},
	{"spi2", "spi2", "test spi2", "Run SPI2 MOSI-to-MISO loopback at two rates.",
	 validation_depth::physical_fixture, "jumper PB15 MOSI to PB14 MISO", test_flag_none,
	 validate_spi2_loopback},
	{"can.internal", "can", "test can internal", "Run CAN1 controller internal loopback.",
	 validation_depth::internal_loopback, "none", test_flag_quick, validate_can_internal},
	{"can.physical", "can", "test can physical", "Exchange frames over CAN1 and CAN2.",
	 validation_depth::physical_fixture, "wire CAN1 H/L/GND to CAN2 H/L/GND", test_flag_none,
	 validate_can_physical},
	{"i2c", "i2c", "test i2c", "Check I2C1 and I2C2 controller initialization.",
	 validation_depth::readiness, "none", test_flag_none, validate_i2c_readiness},
	{"rgb", "rgb", "test rgb", "Show a bounded green, red, blue, and white sequence.",
	 validation_depth::operator_observation, "visually observe onboard RGB LED",
	 test_flag_guided, validate_rgb_colors},
	{"rgb.interactive", "rgb", "test rgb interactive",
	 "Adjust RGB duty percentages until Ctrl+C.", validation_depth::operator_observation,
	 "visually observe onboard RGB LED", test_flag_none, nullptr},
	{"button", "button", "test button [timeout_ms]", "Wait for one bounded user-button press.",
	 validation_depth::operator_observation, "press the onboard user button", test_flag_guided,
	 nullptr},
	{"button.interactive", "button", "test button interactive",
	 "Report debounced button state changes until Ctrl+C.",
	 validation_depth::operator_observation, "press and release the onboard user button",
	 test_flag_none, nullptr},
	{"buzzer", "buzzer", "test buzzer", "Play one bounded onboard buzzer tone.",
	 validation_depth::operator_observation, "listen for the onboard buzzer", test_flag_guided,
	 validate_buzzer_instrumentation},
	{"buzzer.interactive", "buzzer", "test buzzer interactive",
	 "Adjust buzzer frequency and duty until Ctrl+C.", validation_depth::operator_observation,
	 "listen to or measure the onboard buzzer", test_flag_none, nullptr},
	{"servo.interactive", "servo", "test servo unloaded <1-7>",
	 "Adjust one unloaded servo PWM signal until Ctrl+C.", validation_depth::instrumentation,
	 "no servo/load; use an oscilloscope or logic analyzer", test_flag_none, nullptr},
};

} // namespace

const char *validation_depth_name(validation_depth depth)
{
	switch (depth) {
	case validation_depth::readiness:
		return "readiness";
	case validation_depth::functional:
		return "functional";
	case validation_depth::internal_loopback:
		return "internal-loopback";
	case validation_depth::physical_fixture:
		return "physical-fixture";
	case validation_depth::operator_observation:
		return "operator-observation";
	case validation_depth::instrumentation:
		return "instrumentation";
	}

	return "unknown";
}

const test_descriptor *test_catalog(size_t &count)
{
	count = ARRAY_SIZE(tests);
	return tests;
}

const test_descriptor *find_test(const char *id)
{
	for (const test_descriptor &test : tests) {
		if (strcmp(test.id, id) == 0) {
			return &test;
		}
	}

	return nullptr;
}

bool test_has_flag(const test_descriptor &test, test_flags flag)
{
	return (test.flags & static_cast<uint32_t>(flag)) != 0U;
}

int parse_bounded_u32(const char *text, uint32_t minimum, uint32_t maximum, uint32_t &value)
{
	int error = 0;
	const unsigned long parsed = shell_strtoul(text, 10, &error);
	if (error != 0) {
		return -EINVAL;
	}
	if (parsed < minimum || parsed > maximum) {
		return -ERANGE;
	}

	value = static_cast<uint32_t>(parsed);
	return 0;
}

reporter::reporter(const struct shell *output) : output_(output)
{
}

void reporter::begin_test(const test_descriptor &test)
{
	current_test_ = &test;
	current_test_result_ = result_kind::success;
	current_test_has_result_ = false;
	shell_print(output_, "");
	shell_print(output_, "TEST %s", test.command);
	shell_print(output_, "  depth=%s setup=%s", validation_depth_name(test.depth), test.setup);
}

void reporter::end_test()
{
	if (current_test_ == nullptr) {
		return;
	}

	const char *outcome;
	if (!current_test_has_result_) {
		test_error_count_++;
		outcome = "ERROR";
		if (first_error_ == 0) {
			first_error_ = -EIO;
		}
		shell_error(output_, "No terminal result was recorded for %s", current_test_->id);
	} else {
		outcome = result_name(current_test_result_);
		switch (current_test_result_) {
		case result_kind::success:
			test_success_count_++;
			break;
		case result_kind::error:
			test_error_count_++;
			break;
		case result_kind::not_tested:
			test_not_tested_count_++;
			break;
		}
	}

	shell_print(output_, "RESULT: %s - %s [%s]", outcome, current_test_->id,
		    validation_depth_name(current_test_->depth));
	current_test_ = nullptr;
	current_test_has_result_ = false;
}

bool reporter::current_test_has_error() const
{
	return current_test_has_result_ && current_test_result_ == result_kind::error;
}

void reporter::record(result_kind kind, const char *name, const char *detail, int error)
{
	if (current_test_ != nullptr) {
		if (!current_test_has_result_ || kind == result_kind::error ||
		    (kind == result_kind::not_tested &&
		     current_test_result_ == result_kind::success)) {
			current_test_result_ = kind;
		}
		current_test_has_result_ = true;
	}

	if (kind == result_kind::error && first_error_ == 0) {
		first_error_ = error < 0 ? error : -EIO;
	} else if (kind == result_kind::not_tested && first_incomplete_error_ == 0 && error < 0) {
		first_incomplete_error_ = error;
	}

	const char *const depth = current_test_ != nullptr
					  ? validation_depth_name(current_test_->depth)
					  : "unspecified";
	if (detail != nullptr && error != 0) {
		shell_print(output_, "[%s][%s] %s: %s (error %d)", result_name(kind), depth, name,
			    detail, error);
	} else if (detail != nullptr) {
		shell_print(output_, "[%s][%s] %s: %s", result_name(kind), depth, name, detail);
	} else if (error != 0) {
		shell_print(output_, "[%s][%s] %s (error %d)", result_name(kind), depth, name,
			    error);
	} else {
		shell_print(output_, "[%s][%s] %s", result_name(kind), depth, name);
	}
}

void reporter::info(const char *name, const char *detail) const
{
	shell_print(output_, "[INFO] %s: %s", name, detail);
}

int reporter::finish() const
{
	const uint32_t selected = test_success_count_ + test_error_count_ + test_not_tested_count_;
	const char *outcome = "success";
	if (test_error_count_ != 0U) {
		outcome = "error";
	} else if (test_not_tested_count_ != 0U) {
		outcome = "not_tested";
	}

	shell_print(output_, "");
	shell_print(output_,
		    "Run result: %s - selected=%" PRIu32 " success=%" PRIu32 " error=%" PRIu32
		    " not_tested=%" PRIu32,
		    outcome, selected, test_success_count_, test_error_count_,
		    test_not_tested_count_);

	if (first_error_ != 0) {
		return first_error_;
	}
	if (test_not_tested_count_ != 0U) {
		return first_incomplete_error_ != 0 ? first_incomplete_error_ : -EAGAIN;
	}
	return 0;
}

const struct shell *reporter::output() const
{
	return output_;
}

int64_t sensor_value_to_micro(int32_t whole, int32_t fractional)
{
	return static_cast<int64_t>(whole) * 1000000LL + fractional;
}

void print_fixed_point(const reporter &reporter, const char *name, int64_t micro_value,
		       const char *unit)
{
	const bool negative = micro_value < 0;
	const uint64_t magnitude =
		negative ? static_cast<uint64_t>(-micro_value) : static_cast<uint64_t>(micro_value);

	shell_print(reporter.output(), "[INFO] %s: %s%" PRIu64 ".%06" PRIu64 " %s", name,
		    negative ? "-" : "", magnitude / 1000000ULL, magnitude % 1000000ULL, unit);
}

} // namespace type_c_validation
```
