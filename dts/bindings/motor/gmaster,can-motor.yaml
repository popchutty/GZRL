## dts/bindings/motor/gmaster,can-motor.yaml
```yaml
# SPDX-FileCopyrightText: 2026 GMaster contributors
# SPDX-License-Identifier: Apache-2.0

description: |
  GZRL classic CAN motor endpoint. This describes the wire protocol and bus
  topology, not runtime control gains, authorization, or operating limits.
  The application must configure runtime parameters before requesting motion.

compatible: "gmaster,can-motor"

include: base.yaml

properties:
  can:
    type: phandle
    required: true
    description: CAN controller carrying this motor's messages.
  model:
    type: string
    required: true
    enum:
      - "gm6020"
      - "m3508"
      - "m2006"
      - "dm4310"
      - "dm2325"
      - "dm-multi"
      - "lkmg"
    description: Legacy-supported protocol profile; see GZRL motor documentation.
  motor-id:
    type: int
    required: true
    description: Protocol node ID, validated against the selected model at configuration.
  feedback-id:
    type: int
    default: 0
    description: DM MIT master arbitration ID; other models derive their feedback ID.
```

## tests/control/testcase.yaml
```yaml
# SPDX-FileCopyrightText: 2026 GMaster contributors
# SPDX-License-Identifier: Apache-2.0

tests:
  gzrl.control:
    tags:
      - gzrl
      - control
    platform_allow:
      - native_sim
    integration_platforms:
      - native_sim
```

## tests/motor_bus/loopback/testcase.yaml
```yaml
# SPDX-FileCopyrightText: 2026 GMaster contributors
# SPDX-License-Identifier: Apache-2.0
tests:
  gzrl.motor.bus.loopback:
    platform_allow:
      - native_sim
      - native_sim/native/64
    integration_platforms:
      - native_sim
    tags:
      - gzrl
      - motor
      - can
```

## tests/motor_core/testcase.yaml
```yaml
# SPDX-FileCopyrightText: 2026 GMaster contributors
# SPDX-License-Identifier: Apache-2.0

tests:
  gzrl.motor.core:
    tags:
      - gzrl
      - motor
    platform_allow:
      - native_sim
    integration_platforms:
      - native_sim
```

## zephyr/Kconfig
```kconfig
# SPDX-FileCopyrightText: 2026 GMaster contributors
# SPDX-License-Identifier: Apache-2.0

menuconfig GZRL
	bool "GZRL robot library"
	help
	  Enable the GMaster Zephyr Robot Library integration layer.

if GZRL

config GZRL_CONTROL
	bool "Portable control algorithms"
	help
	  Enable independent PID, cascade, angle and fixed-storage filter primitives.

config GZRL_MOTOR_CORE
	bool "Portable motor protocols"
	help
	  Enable byte-wise codecs and feedback tracking for DJI, Damiao and LK motors.

config GZRL_MOTOR
	bool "CAN motor devices and application-driven scheduling"
	depends on CAN
	select GZRL_MOTOR_CORE
	help
	  Instantiate motor devices from Devicetree and provide bounded receive
	  processing, explicit lifecycle management and asynchronous grouped sending.

if GZRL_MOTOR

config GZRL_MOTOR_INIT_PRIORITY
	int "Motor device initialization priority"
	default 90

config GZRL_MOTOR_MAX_DEVICES
	int "Maximum motors in one bus coordinator"
	range 1 32
	default 16

config GZRL_MOTOR_RX_DEPTH
	int "Receive queue depth per bus"
	range 4 256
	default 64

endif
endif
```
