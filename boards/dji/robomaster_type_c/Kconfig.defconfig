## boards/dji/robomaster_type_c/Kconfig.defconfig
```kconfig
# SPDX-FileCopyrightText: 2026 GMaster contributors
# SPDX-License-Identifier: Apache-2.0

if BOARD_ROBOMASTER_TYPE_C

source "boards/common/usb/Kconfig.cdc_acm_serial.defconfig"

if BMI08X

# Zephyr v4.4.1's BMI08X driver always initializes its RTIO bus.
config SENSOR_ASYNC_API
	default y

endif # BMI08X

endif # BOARD_ROBOMASTER_TYPE_C
```

## boards/dji/robomaster_type_c/Kconfig.robomaster_type_c
```kconfig
# SPDX-FileCopyrightText: 2026 GMaster contributors
# SPDX-License-Identifier: Apache-2.0

config BOARD_ROBOMASTER_TYPE_C
	select SOC_STM32F407XG
```

## boards/dji/robomaster_type_c/board.yml
```yaml
# SPDX-FileCopyrightText: 2026 GMaster contributors
# SPDX-License-Identifier: Apache-2.0

board:
  name: robomaster_type_c
  full_name: RoboMaster Development Board Type C
  vendor: dji
  socs:
    - name: stm32f407xx
```

## west.yml
```yaml
# SPDX-FileCopyrightText: 2026 GMaster contributors
# SPDX-License-Identifier: Apache-2.0

manifest:
  remotes:
    - name: zephyrproject-rtos
      url-base: https://github.com/zephyrproject-rtos

  projects:
    - name: zephyr
      remote: zephyrproject-rtos
      revision: v4.4.1
      import: true

  self:
    path: GZRL
```
